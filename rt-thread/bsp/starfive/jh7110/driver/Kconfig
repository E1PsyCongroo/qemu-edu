## rt-thread/bsp/starfive/jh7110/driver/Kconfig
```kconfig
menu "RISC-V 64 configs"

config RISCV_S_MODE
    bool "RT-Thread run in RISC-V S-Mode(supervisor mode)"
    default y

config RT_USING_VIRTIO
    bool "Using VirtIO"
    default n
    depends on RT_USING_DEVICE_OPS

config DRV_USING_OPENAMP
    bool "Using openAMP"
    default n

endmenu
```
